
&mdss_mdp {
	dsi_himax_boe_video: qcom,mdss_dsi_himax_boe_video {
		qcom,mdss-dsi-panel-name = "himax boe video mode dsi panel";
		qcom,mdss-dsi-panel-type = "dsi_video_mode";
		qcom,mdss-dsi-virtual-channel-id = <0>;
		qcom,mdss-dsi-stream = <0>;
		qcom,mdss-dsi-h-left-border = <0>;
		qcom,mdss-dsi-h-right-border = <0>;
		qcom,mdss-dsi-v-top-border = <0>;
		qcom,mdss-dsi-v-bottom-border = <0>;
		qcom,mdss-dsi-bpp = <24>;
		qcom,mdss-dsi-color-order = "rgb_swap_rgb";
		qcom,mdss-dsi-underflow-color = <0xff>;
		qcom,mdss-dsi-border-color = <0>;
		qcom,mdss-dsi-h-sync-pulse = <0>;
		qcom,mdss-dsi-traffic-mode = "non_burst_sync_event";
		qcom,mdss-dsi-lane-map = "lane_map_0123";
		qcom,mdss-dsi-bllp-eof-power-mode;
		qcom,mdss-dsi-bllp-power-mode;
		qcom,mdss-dsi-tx-eot-append;
		qcom,mdss-dsi-lane-0-state;
		qcom,mdss-dsi-lane-1-state;
		qcom,mdss-dsi-lane-2-state;
		qcom,mdss-dsi-lane-3-state;
		qcom,mdss-dsi-dma-trigger = "trigger_sw";
		qcom,mdss-dsi-mdp-trigger = "none";
		qcom,mdss-dsi-lp11-init;
		qcom,mdss-dsi-reset-sequence = <1 20>, <0 20>, <1 50>;
		qcom,mdss-dsi-panel-orientation = "180";
		qcom,esd-check-enabled;
		qcom,mdss-dsi-panel-status-check-mode = "reg_read";
		qcom,mdss-dsi-panel-status-command = [06 01 00 00 0a 00 01 0a
					06 01 00 00 0a 00 01 09
					06 01 00 00 0a 00 01 45];
		qcom,mdss-dsi-panel-status-command-state = "dsi_lp_mode";
		qcom,mdss-dsi-panel-status-value = <0x9d 0x80 0x08>;
		qcom,mdss-dsi-panel-on-check-value = <0x80>;
		qcom,mdss-dsi-panel-status-read-length = <4 4 4>;
		qcom,mdss-dsi-panel-status-valid-params = <1 1 1>;
		qcom,mdss-dsi-panel-max-error-count = <3>;
		qcom,dsi-ctrl-num = <0>;
		qcom,dsi-phy-num = <0>;
		qcom,mdss-dsi-t-clk-post = <2>;
		qcom,mdss-dsi-t-clk-pre = <0x2d>;
		qcom,dsi-select-clocks = "mux_byte_clk0", "mux_pixel_clk0";

		qcom,mdss-dsi-display-timings {
			timing@0 {
				qcom,mdss-dsi-panel-width = <0x4b0>;
				qcom,mdss-dsi-panel-height = <0x7d0>;
				qcom,mdss-dsi-h-front-porch = <0x14>;
				qcom,mdss-dsi-h-back-porch = <0x10>;
				qcom,mdss-dsi-h-pulse-width = <0x08>;
				qcom,mdss-dsi-h-sync-skew = <0>;
				qcom,mdss-dsi-v-back-porch = <0x26>;
				qcom,mdss-dsi-v-front-porch = <0x50>;
				qcom,mdss-dsi-v-pulse-width = <0x08>;
				qcom,mdss-dsi-panel-framerate = <60>;
				qcom,mdss-dsi-on-command = [39 01 00 00 00 00 04 b9 83 10 2e
					15 01 00 00 00 00 02 e9 cd
					15 01 00 00 05 00 02 bb 01
					15 01 00 00 00 00 02 e9 00
					39 01 00 00 00 00 05 d1 67 0c ff 05
					39 01 00 00 00 00 12 b1 10 fa af af 2b 2b b2 57 4d 36 36 36 36 22 21 15 00
					39 01 00 00 00 00 11 b2 00 b0 47 d0 00 2c 50 2c 00 00 00 00 15 20 d7 00
					39 01 00 00 00 00 11 b4 70 60 01 01 80 67 00 00 01 9b 01 58 00 ff 00 ff
					39 01 00 00 00 00 04 bf fc 85 80
					39 01 00 00 00 00 03 d2 2b 2b
					39 01 00 00 05 00 2c d3 00 00 00 00 78 04 00 04 00 27 00 64 4f 2d 2d 00 00 32 10 27 00 27 32 10 23 00 23 32 18 03 08 03 00 00 20 30 01 55 21 2e 01 55 0f
					39 01 00 00 05 00 2f e0 00 06 11 19 21 3b 53 5a 60 5b 74 78 7d 8a 87 8f 98 aa aa 54 5b 66 70 00 06 11 19 21 3b 53 5a 60 5b 74 78 7d 8a 87 8f 98 aa aa 54 5b 66 70
					15 01 00 00 00 00 02 bd 01
					39 01 00 00 00 00 05 b1 01 9b 01 31
					39 01 00 00 00 00 0b cb f4 36 12 16 c0 28 6c 85 3f 04
					39 01 00 00 05 00 0c d3 01 00 bc 00 00 11 10 00 0e 00 01
					15 01 00 00 00 00 02 bd 02
					39 01 00 00 00 00 07 b4 4e 00 33 11 33 88
					39 01 00 00 00 00 04 bf f2 00 02
					15 01 00 00 00 00 02 bd 00
					39 01 00 00 00 00 0f c0 23 23 22 11 a2 17 00 80 00 00 08 00 63 63
					15 01 00 00 00 00 02 c6 f9
					15 01 00 00 00 00 02 c7 30
					39 01 00 00 00 00 09 c8 00 04 04 00 00 85 43 ff
					39 01 00 00 00 00 04 d0 07 04 05
					39 01 00 00 05 00 2d d5 18 18 18 18 1a 1a 1a 1a 1b 1b 1b 1b 24 24 24 24 07 06 07 06 05 04 05 04 03 02 03 02 01 00 01 00 21 20 21 20 18 18 18 18 18 18 18 18
					39 01 00 00 00 00 18 e7 12 13 02 02 49 49 0e 0e 0f 1a 1d 74 28 74 01 07 00 00 00 00 17 00 68
					15 01 00 00 00 00 02 bd 01
					39 01 00 00 00 00 08 e7 02 38 01 93 0d da 0e
					15 01 00 00 00 00 02 bd 02
					39 01 00 00 00 00 1d e7 ff 01 ff 01 00 00 22 00 00 00 00 00 00 00 00 00 00 00 00 00 00 00 00 00 81 00 02 40
					15 01 00 00 00 00 02 bd 00
					39 01 00 00 00 00 09 ba 70 03 a8 83 f2 80 c0 0d
					15 01 00 00 00 00 02 bd 02
					39 01 00 00 00 00 0d d8 ff ff ff ff f0 00 ff ff ff ff f0 00
					15 01 00 00 00 00 02 bd 03
					39 01 00 00 00 00 19 d8 aa aa aa aa a0 00 aa aa aa aa a0 00 55 55 55 55 50 00 55 55 55 55 50 00
					15 01 00 00 00 00 02 bd 00
					39 01 00 00 00 00 03 e1 01 06
					15 01 00 00 00 00 02 cc 02
					15 01 00 00 00 00 02 bd 03
					15 01 00 00 00 00 02 b2 80
					15 01 00 00 00 00 02 bd 00
					39 01 00 00 00 00 03 51 00 00
					15 01 00 00 00 00 02 53 2c
					39 01 00 00 00 00 05 c9 00 0d f0 00
					05 01 00 00 3c 00 01 11
					39 01 00 00 00 00 11 b2 00 b0 47 d0 00 2c 50 2c 00 00 00 00 15 20 d7 00
					05 01 00 00 14 00 01 29];
				qcom,mdss-dsi-off-command = [05 01 00 00 1e 00 02 28 00 05 01 00 00 3c 00 02 10 00];
				qcom,mdss-dsi-on-command-state = "dsi_lp_mode";
				qcom,mdss-dsi-off-command-state = "dsi_lp_mode";
				qcom,mdss-dsi-panel-phy-timings = <0x200808 0x24230808 0x8020400>;
				qcom,display-topology = <1 0 1>;
				qcom,default-topology-index = <0>;
			};
		};
	};
};
